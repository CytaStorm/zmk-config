## config/boards/shields/lulu/Kconfig.defconfig
```kconfig
# Copyright 2022 jack (@waffle87)
# SPDX-License-Identifier: MIT

CONFIG_ZMK_USB_LOGGING=y
if SHIELD_LULU_LEFT
config ZMK_KEYBOARD_NAME
  default "lulu"

config ZMK_SPLIT_ROLE_CENTRAL
  default y
endif

if SHIELD_LULU_LEFT || SHIELD_LULU_RIGHT
config ZMK_SPLIT
  default y
endif
```
